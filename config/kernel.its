## config/kernel.its
```
/*
 * Simple U-boot uImage source file containing a single kernel
 */

/dts-v1/;

/ {
        description = "BBS Firmware";
        #address-cells = <1>;

        images {
                kernel@1 {
                        description = "SAMA5 Linux Kernel";
                        data = /incbin/("vmlinuz-5.14.0-771261-g9d7ae926527f");
                        type = "kernel";
                        arch = "riscv";
                        os = "linux";
                        compression = "none";
                        load =  <0x40200000>; /* das ist die addresse an die der kernel kopiert wird */
                        entry = <0x40200000>;
                        hash@1 { algo = "sha1"; };
                };
                
                kernel@2 {
                        description = "SAMA5 Linux Kernel";
                        data = /incbin/("Image");
                        type = "kernel";
                        arch = "riscv";
                        os = "linux";
                        compression = "none";
                        load =  <0x40200000>; /* das ist die addresse an die der kernel kopiert wird */
                        entry = <0x40200000>;
                        hash@1 { algo = "sha1"; };
                };
                
                kernel@3 {
                        description = "SAMA5 Linux Kernel";
                        data = /incbin/("vmlinux-5.4.61+");
                        type = "kernel";
                        arch = "riscv";
                        os = "linux";
                        compression = "none";
                        load =  <0x40200000>; /* das ist die addresse an die der kernel kopiert wird */
                        entry = <0x40200000>;
                        hash@1 { algo = "sha1"; };
                };
                
                kernel@4 {
                        description = "SAMA5 Linux Kernel";
                        data = /incbin/("vmlinuz-5.10.6-200.0.riscv64.fc33.riscv64");
                        type = "kernel";
                        arch = "riscv";
                        os = "linux";
                        compression = "none";
                        load =  <0x40200000>; /* das ist die addresse an die der kernel kopiert wird */
                        entry = <0x40200000>;
                        hash@1 { algo = "sha1"; };
                };
                
                
                fdt@DevelBoard1 {
                        description = "M8+2TX_IP67 A Muster";
                        data = /incbin/("allwinner-d1-nezha-kit.dtb");
                        type = "flat_dt";
                        arch = "riscv";
                        compression = "none";
                        hash@1 { algo = "sha1"; };
                };
                
                fdt@DevelBoard2 {
                        description = "M8+2TX_IP67 A Muster";
                        data = /incbin/("sun20i-d1-nezha.dtb");
                        type = "flat_dt";
                        arch = "riscv";
                        compression = "none";
                        hash@1 { algo = "sha1"; };
                };
                
                fdt@DevelBoard3 {
                        description = "M8+2TX_IP67 A Muster";
                        data = /incbin/("aw_nezha_d1_2G.dtb");
                        type = "flat_dt";
                        arch = "riscv";
                        compression = "none";
                        hash@1 { algo = "sha1"; };
                };
                
                
                
        };

        configurations {
                default = "DevelBoard2";
                
                DevelBoard1 {
                        description = "Boot Config DevelBoard";
                        kernel = "kernel@1";
                        fdt = "fdt@DevelBoard1";
                };
                
                DevelBoard2 {
                        description = "Boot Config DevelBoard";
                        kernel = "kernel@1";
                        fdt = "fdt@DevelBoard2";
                };
                
                DevelBoard3 {
                        description = "Boot Config DevelBoard";
                        kernel = "kernel@2";
                        fdt = "fdt@DevelBoard1";
                };
                
                DevelBoard4 {
                        description = "Boot Config DevelBoard";
                        kernel = "kernel@2";
                        fdt = "fdt@DevelBoard2";
                };
                
                /* Das Funktioniert */
                DevelBoard5 {
                        description = "Boot Config DevelBoard";
                        kernel = "kernel@3";
                        fdt = "fdt@DevelBoard3";
                };
                
                DevelBoard6 {
                        description = "Boot Config DevelBoard";
                        kernel = "kernel@4";
                        fdt = "fdt@DevelBoard3";
                };
                
                
                DevelBoard7 {
                        description = "Boot Config DevelBoard";
                        kernel = "kernel@1";
                        fdt = "fdt@DevelBoard3";
                };
                
                DevelBoard8 {
                        description = "Boot Config DevelBoard";
                        kernel = "kernel@2";
                        fdt = "fdt@DevelBoard3";
                };
        };
};
```
